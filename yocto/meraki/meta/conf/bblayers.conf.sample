## yocto/meraki/meta/conf/bblayers.conf.sample
```bitbake
# POKY_BBLAYERS_CONF_VERSION is increased each time build/conf/bblayers.conf
# changes incompatibly
POKY_BBLAYERS_CONF_VERSION = "2"

BBPATH = "${TOPDIR}"
BBFILES ?= ""

OEBASE = "##OEROOT##/.."

BBLAYERS ?= " \
  ${OEBASE}/meraki/meta \
  ${OEBASE}/poky/meta \
  ${OEBASE}/poky/meta-poky \
  ${OEBASE}/meta-openembedded/meta-python \
  ${OEBASE}/meta-openembedded/meta-oe \
  ${OEBASE}/meta-openembedded/meta-networking \
  ${OEBASE}/meta-openembedded/meta-filesystems \
  ${OEBASE}/poky/meta-yocto-bsp \
  "
```

## yocto/meraki/meta/conf/distro/meraki-host.conf
```bitbake
require conf/distro/poky-tiny.conf

PREFERRED_PROVIDER_virtual/kernel_meraki = "linux-dummy"
LINUXLIBCVERSION = "4.%"
LINUX_VERSION = "N/A"

GCCVERSION = '7.%'

PREFERRED_PROVIDER_virtual/wifi-driver = "wlan"
PREFERRED_VERSION_wlan = "10.4"

require conf/distro/meraki.inc

DISTRO = "meraki-host"
DISTROOVERRIDES = "poky:meraki"
```

## yocto/meraki/meta/conf/distro/meraki-kernel.inc
```bitbake
# Distro config is evaluated after the machine config, so we have to explicitly
# set the kernel provider to override a machine config.
PREFERRED_PROVIDER_virtual/kernel = "linux-meraki"

# Distro config is evaluated after the machine config, so we have to explicitly
# set the kernel provider to override a machine config.
PREFERRED_PROVIDER_linux-libc-headers = "meraki-linux-libc-headers"

# We always want to use the same version for linux-libc-headers as the kernel.
# Poky takes a different approach always uses a "standard" set of headers from
# an upstream kernel. That doesn't make any sense and so we have our own recipe
# for linux-libc-headers that uses the main kernel's sources and therefore
# should match the version of the main kernel.
LINUXLIBCVERSION ?= "${PREFERRED_VERSION_linux-meraki}"
LINUX_VERSION = "${PREFERRED_VERSION_linux-meraki}"
```

## yocto/meraki/meta/conf/distro/meraki-musl.conf
```bitbake
# Distribution definition for: meraki-musl
#
# Copyright (c) 2011, Intel Corporation.
# All rights reserved.
#
# This file is released under the MIT license as described in
# poky/meta/COPYING.MIT.
#

require conf/distro/poky-tiny.conf
require conf/distro/meraki-kernel.inc
require conf/distro/meraki.inc
DISTRO = "meraki-musl"
DISTROOVERRIDES = "poky:meraki"

# Build for size
FULL_OPTIMIZATION = "-Os -pipe ${DEBUG_FLAGS}"
```

## yocto/meraki/meta/conf/distro/meraki.inc
```bitbake
# Distribution definition for: meraki
#
# Copyright (c) 2011, Intel Corporation.
# All rights reserved.
#
# This file is released under the MIT license as described in
# poky/meta/COPYING.MIT.
#

# Fetch all files from dl.meraki.net if possible
SOURCE_MIRROR_URL = "https://dl.meraki.net/"
INHERIT += "own-mirrors"

UNINATIVE_URL = "${SOURCE_MIRROR_URL}uninative/1.9/"

PREFERRED_VERSION_util-linux = "2.34"
PNBLACKLIST[util-linux] ?= "${@'Only version ' + d.getVar('PREFERRED_VERSION_${BPN}') + ' (not ${PV}) is supported in this configuration. ' if d.getVar('PREFERRED_VERSION_${BPN}') and not d.getVar('PV').startswith(d.getVar('PREFERRED_VERSION_${BPN}').replace('%', '')) else ''}"

BINUVERSION = "2.35%"

PREFERRED_PROVIDER_libdevmapper = "lvm2"

RDEPENDS_kernel-base = ""

# Avoid installing "recommended" packages
NO_RECOMMENDATIONS = "1"

# Where we're going... we don't need no dev_manager!
VIRTUAL-RUNTIME_dev_manager = ""

# Where we're going... we don't need no init_manager!
VIRTUAL-RUNTIME_init_manager = ""

# Disable graphics
XSERVER = ""

# Don't create symlinks for externalsrc. They pollute the source directories.
EXTERNALSRC_SYMLINKS = ""

# remove the ROOTFS_RO_UNNEEDED packages like base-passwd and update-alternatives
FORCE_RO_REMOVE = "1"

# NOTE We do not add "pam" here as we don't want to enable libpam support in
# recipes; we do however build libpam independently.
DISTRO_FEATURES="pci ipv4 ipv6 usbhost largefile gobject-introspection-data"

include build-configuration.inc
```

## yocto/meraki/meta/conf/layer.conf
```bitbake
# Provides colors for pretty printing in shell.
include colors.conf

# We have a conf and classes directory, add to BBPATH
BBPATH .= ":${LAYERDIR}"

# We have a recipes-* directories, add to BBFILES
BBFILES += "${LAYERDIR}/recipes-*/*/*.bb \
	${LAYERDIR}/recipes-*/*/*.bbappend"

# Set priority of layer
BBFILE_COLLECTIONS += "meraki"
BBFILE_PATTERN_meraki = "^${LAYERDIR}/"
BBFILE_PRIORITY_meraki = "7"

# Require these tools to be available on host
HOSTTOOLS += "rsync uuencode java tsort mkfifo whoami"
HOSTTOOLS += "docker"
```

## yocto/meraki/meta/conf/machine/include/arm/arch-armv7a-nofpu.inc
```bitbake
require conf/machine/include/arm/arch-armv7a.inc

# Do not use floating point support at all
DEFAULTTUNE = "armv7a"
TUNE_FEATURES_remove = "vfp"
```

## yocto/meraki/meta/conf/machine/wired-arm-qca.conf
```bitbake
require conf/machine/include/arm/arch-armv7a-nofpu.inc

GCCVERSION = "7.%"
PREFERRED_VERSION_linux-meraki = "4.4-mx"

# Older kernel needs an older iproute2.
PREFERRED_VERSION_iproute2 = "3.3.0"

# Used to select features in packagegroup-meraki-base
MERAKI_FEATURES += "\
    clientvpn \
    "

KERNEL_IMAGETYPE = "zImage"
KERNEL_DEVICETREE = "fairyfly.dtb"
INITRAMFS_FSTYPES = "cpio.xz"

# _meraki suffix required to override definition in poky-tiny
MACHINE_ESSENTIAL_EXTRA_RDEPENDS_meraki += "kernel-modules"
```
